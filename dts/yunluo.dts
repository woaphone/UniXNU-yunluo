/dts-v1/;
/include/ "mt6789.dtsi"
/ {
    model = "Xiaomi Redmi Pad (yunluo)";
    compatible = "xiaomi,yunluo", "mediatek,mt6789";
    memory@40000000 {
        device_type = "memory";
        reg = <0 0x40000000 1 0x80000000>;
    };
};
